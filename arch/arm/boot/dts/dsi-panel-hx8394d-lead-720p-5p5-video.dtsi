/* Copyright (c) 2013, The Linux Foundation. All rights reserved.
 *
 * This program is free software; you can redistribute it and/or modify
 * it under the terms of the GNU General Public License version 2 and
 * only version 2 as published by the Free Software Foundation.
 *
 * This program is distributed in the hope that it will be useful,
 * but WITHOUT ANY WARRANTY; without even the implied warranty of
 * MERCHANTABILITY or FITNESS FOR A PARTICULAR PURPOSE.  See the
 * GNU General Public License for more details.
 */

/*---------------------------------------------------------------------------
 * This file is autogenerated file using gcdb parser. Please do not edit it.
 * Update input XML file to add a new entry or update variable in this file
 * VERSION = "1.0"
 *---------------------------------------------------------------------------*/
&mdss_mdp {
	dsi_hx8394d_lead_720p_5p5_vid: qcom,mdss_dsi_hx8394d_lead_720p_5p5_video {
		qcom,mdss-dsi-panel-name = "hx8394d lead 720p 5p5 video mode dsi panel";
        qcom,cont-splash-enabled;
		qcom,mdss-dsi-panel-controller = <&mdss_dsi0>;
		qcom,mdss-dsi-panel-type = "dsi_video_mode";
		qcom,mdss-dsi-panel-destination = "display_1";
		qcom,mdss-dsi-panel-framerate = <60>;
		qcom,mdss-dsi-virtual-channel-id = <0>;
		qcom,mdss-dsi-stream = <0>;
		/*qcom,mdss-dsi-panel-width = <720>;
		qcom,mdss-dsi-panel-height = <1280>;
		qcom,mdss-dsi-h-front-porch = <170>;
		qcom,mdss-dsi-h-back-porch = <150>;
		qcom,mdss-dsi-h-pulse-width = <28>;
		qcom,mdss-dsi-h-sync-skew = <0>;
		qcom,mdss-dsi-v-back-porch = <32>;
		qcom,mdss-dsi-v-front-porch = <32>;
		qcom,mdss-dsi-v-pulse-width = <1>;*/
        qcom,mdss-dsi-panel-width = <720>;
		qcom,mdss-dsi-panel-height = <1280>;
		qcom,mdss-dsi-h-front-porch = <140>;
		qcom,mdss-dsi-h-back-porch = <164>;
		qcom,mdss-dsi-h-pulse-width = <8>;
		qcom,mdss-dsi-h-sync-skew = <0>;
		qcom,mdss-dsi-v-back-porch = <12>;
		qcom,mdss-dsi-v-front-porch = <6>;
		qcom,mdss-dsi-v-pulse-width = <2>;
        
		qcom,mdss-dsi-h-left-border = <0>;
		qcom,mdss-dsi-h-right-border = <0>;
		qcom,mdss-dsi-v-top-border = <0>;
		qcom,mdss-dsi-v-bottom-border = <0>;
		qcom,mdss-dsi-bpp = <24>;
		qcom,mdss-dsi-underflow-color = <0xff>;
		qcom,mdss-dsi-border-color = <0>;
		qcom,mdss-dsi-on-command = [
                    39 01 00 00 00 00 04 B9 FF 83 94
                    39 01 00 00 00 00 10 BA 33 83 a0 6d b2 00 09 40 50 ff 0f 00 08 3d 16
                    39 01 00 00 00 00 10 B1 6C 12 12 23 04 11 F1 80 99 9F 23 80 C0 D2 58
                    39 01 00 00 00 00 0C B2 00 64 0E 0D 12 23 08 08 1C 4D 00
                    39 01 00 00 00 00 0D B4 00 FF 57 58 57 58 57 58 01 6C 01 6C
                    39 01 00 00 00 00 02 BC 07
                    39 01 00 00 00 00 04 BF 41 0e 01
                    39 01 00 00 00 00 1F D3 00 00 00 00 00 18 10 32 10 00 00 00 32 13 C0 00 00 32 10 08 00 00 47 04 02 02 47 04 00 47
                    39 01 00 00 00 00 2D D5 00 01 02 03 04 05 06 07 20 21 22 23 18 18 18 18 18 18 18 18 18 18 18 18 18 18 18 18 18 18 18 18 18 18 18 18 18 18 18 18 19 19 18 18
                    39 01 00 00 00 00 2D D6 07 06 05 04 03 02 01 00 23 22 21 20 18 18 18 18 18 18 18 18 18 18 18 18 18 18 18 18 18 18 18 18 18 18 18 18 18 18 18 18 18 18 19 19
                    39 01 00 00 00 00 2B E0 00 0E 15 3A 3C 3F 21 3D 06 09 0B 15 0C 12 15 15 16 06 0D 11 17 00 0E 15 3A 3C 3F 21 3D 06 09 0B 15 0C 12 15 15 16 06 0D 11 17

                    /* 3gamma start */
                    39 01 00 00 00 00 02 BD 00
                    39 01 00 00 00 00 2C /*R*/
                        C1 01 00 09 
                        10 15 1A 24 
                        2C 32 3D 48 
                        51 59 62 69 
                        70 78 80 88 
                        90 99 A0 A7 
                        AF B7 C0 CB 
                        D1 D8 E1 E9 
                        F2 F9 FF 07 
                        C3 D7 6D 0A 
                        F3 DB A4 C0

                    39 01 00 00 00 00 02 BD 01
                    39 01 00 00 00 00 2B /*G*/
                        C1 00 09 10 
                        15 1A 24 2C 
                        32 3D 48 51 
                        59 62 69 70 
                        78 80 88 90 
                        99 A0 A7 AF 
                        B7 C0 CB D1 
                        D8 E1 E9 F2 
                        F9 FF 07 C3 
                        D7 6D 0A F3 
                        DB A4 C0 

                    39 01 00 00 00 00 02 BD 02
                    39 01 00 00 00 00 2B /*B*/
                        C1 00 09 10 
                        15 1A 24 2C 
                        32 3D 48 51 
                        59 62 69 70 
                        78 80 88 90 
                        99 A0 A7 AF 
                        B7 C0 CB D1 
                        D8 E1 E9 F2 
                        F9 FF 07 C3 
                        D7 6D 0A F3 
                        DB A4 C0 
                    /* 3gamma end */
                    
                    39 01 00 00 00 00 02 CC 09
                    39 01 00 00 00 00 03 C0 30 14
                    /*39 01 00 00 00 00 02 D2 44*/
                    39 01 00 00 05 00 05 C7 00 C0 40 C0
                    39 01 00 00 05 00 03 B6 43 43 /* set vcom */

                    /* ce */
                    /*39 01 00 00 05 00 03 E6 80 18
                    39 01 00 00 20 00 03 E4 03 01*/
                    
                    /*39 01 00 00 05 00 02 51 ff
                    39 01 00 00 05 00 02 53 2c
                    39 01 00 00 20 00 02 55 01*/

                    39 01 00 00 20 00 03 E4 03 01 /* 03 E4 FD 01 */
                    
					05 01 00 00 64 00 02 11 00
                    05 01 00 00 78 00 02 29 00];
		qcom,mdss-dsi-off-command = [05 01 00 00 32 00 02 28 00
				05 01 00 00 78 00 02 10 00];
		qcom,mdss-dsi-on-command-state = "dsi_lp_mode";
		qcom,mdss-dsi-off-command-state = "dsi_hs_mode";
		qcom,mdss-dsi-h-sync-pulse = <1>;
		qcom,mdss-dsi-traffic-mode = "burst_mode";
		qcom,mdss-dsi-bllp-eof-power-mode;
		qcom,mdss-dsi-bllp-power-mode;
		qcom,mdss-dsi-lane-0-state;
		qcom,mdss-dsi-lane-1-state;
		qcom,mdss-dsi-lane-2-state;
		qcom,mdss-dsi-lane-3-state;
		qcom,mdss-dsi-panel-timings = [7d 25 1d 00 37 33 22 27 1e 03 04 00];
        /*qcom,mdss-dsi-panel-timings = [83 1e 13 00 34 3a 18 22 24 03 04 a0];*/
		qcom,mdss-dsi-t-clk-post = <0x20>;
		qcom,mdss-dsi-t-clk-pre = <0x2c>;
		qcom,mdss-dsi-bl-min-level = <1>;
		qcom,mdss-dsi-bl-max-level = <255>;
		qcom,mdss-dsi-dma-trigger = "trigger_sw";
		qcom,mdss-dsi-mdp-trigger = "none";
		qcom,mdss-dsi-bl-pmic-control-type = "bl_ctrl_dcs";
		qcom,mdss-dsi-reset-sequence = <1 20>, <0 1>, <1 180>;
		qcom,mdss-pan-physical-width-dimension = <59>;
		qcom,mdss-pan-physical-height-dimension = <104>;

	};
};
