/* Copyright (c) 2013, The Linux Foundation. All rights reserved.
 *
 * This program is free software; you can redistribute it and/or modify
 * it under the terms of the GNU General Public License version 2 and
 * only version 2 as published by the Free Software Foundation.
 *
 * This program is distributed in the hope that it will be useful,
 * but WITHOUT ANY WARRANTY; without even the implied warranty of
 * MERCHANTABILITY or FITNESS FOR A PARTICULAR PURPOSE.  See the
 * GNU General Public License for more details.
 */

/*---------------------------------------------------------------------------
 * This file is autogenerated file using gcdb parser. Please do not edit it.
 * Update input XML file to add a new entry or update variable in this file
 * VERSION = "1.0"
 *---------------------------------------------------------------------------*/
&mdss_mdp {
	dsi_otm1283a_boe_720p_vid: qcom,mdss_dsi_otm1283a_boe_720p_video {
		qcom,mdss-dsi-panel-name = "otm1283 boe 720p video mode dsi panel";
        qcom,cont-splash-enabled;
		qcom,mdss-dsi-panel-controller = <&mdss_dsi0>;
		qcom,mdss-dsi-panel-type = "dsi_video_mode";
		qcom,mdss-dsi-panel-destination = "display_1";
		qcom,mdss-dsi-panel-framerate = <60>;
		qcom,mdss-dsi-virtual-channel-id = <0>;
		qcom,mdss-dsi-stream = <0>;
		qcom,mdss-dsi-panel-width = <720>;
		qcom,mdss-dsi-panel-height = <1280>;
		qcom,mdss-dsi-h-front-porch = <170>;
		qcom,mdss-dsi-h-back-porch = <150>;
		qcom,mdss-dsi-h-pulse-width = <28>;
		qcom,mdss-dsi-h-sync-skew = <0>;
		qcom,mdss-dsi-v-back-porch = <32>;
		qcom,mdss-dsi-v-front-porch = <32>;
		qcom,mdss-dsi-v-pulse-width = <1>;
		qcom,mdss-dsi-h-left-border = <0>;
		qcom,mdss-dsi-h-right-border = <0>;
		qcom,mdss-dsi-v-top-border = <0>;
		qcom,mdss-dsi-v-bottom-border = <0>;
		qcom,mdss-dsi-bpp = <24>;
		qcom,mdss-dsi-underflow-color = <0xff>;
		qcom,mdss-dsi-border-color = <0>;
		qcom,mdss-dsi-on-command = [
                    29 01 00 00 00 00 02 00 00
                    29 01 00 00 00 00 04 ff 12 83 01
                    29 01 00 00 00 00 02 00 80
                    29 01 00 00 00 00 03 ff 12 83
                    29 01 00 00 00 00 02 00 80
                    29 01 00 00 00 00 0a c0 00 64 00 0f 11 00 64 0f 11
29 01 00 00 00 00 02 00 90
	29 01 00 00 00 00 07 c0 00 5c 00 01 00 04
29 01 00 00 00 00 02 00 a4
	29 01 00 00 00 00 02 c0 00
29 01 00 00 00 00 02 00 b3
	29 01 00 00 00 00 03 c0 00 50
29 01 00 00 00 00 02 00 81
	29 01 00 00 00 00 02 c1 55
29 01 00 00 00 00 02 00 81
	29 01 00 00 00 00 02 c4 82
29 01 00 00 00 00 02 00 82
	29 01 00 00 00 00 02 c4 02
29 01 00 00 00 00 02 00 90
	29 01 00 00 00 00 02 c4 49
29 01 00 00 00 00 02 00 c6
	29 01 00 00 00 00 02 b0 03
29 01 00 00 00 00 02 00 91
	29 01 00 00 00 00 02 c0 55
29 01 00 00 00 00 02 00 90
	29 01 00 00 00 00 05 f5 02 11 02 11
29 01 00 00 00 00 02 00 90
	29 01 00 00 00 00 02 c5 50
29 01 00 00 00 00 02 00 94
	29 01 00 00 00 00 02 c5 66
29 01 00 00 00 00 02 00 b2
	29 01 00 00 00 00 03 f5 00 00
29 01 00 00 00 00 02 00 b4
	29 01 00 00 00 00 03 f5 00 00
29 01 00 00 00 00 02 00 b6
	29 01 00 00 00 00 03 f5 00 00
29 01 00 00 00 00 02 00 b8
	29 01 00 00 00 00 03 f5 00 00
29 01 00 00 00 00 02 00 94
	29 01 00 00 00 00 02 f5 02
29 01 00 00 00 00 02 00 ba
	29 01 00 00 00 00 02 f5 03
29 01 00 00 00 00 02 00 b2
	29 01 00 00 00 00 02 c5 40
29 01 00 00 00 00 02 00 b4
	29 01 00 00 00 00 02 c5 c0
29 01 00 00 00 00 02 00 a0
	29 01 00 00 00 00 0f c4 05 10 06 02 05 15 10 05 10 07 02 05 15 10
29 01 00 00 00 00 02 00 b0
	29 01 00 00 00 00 03 c4 00 00
29 01 00 00 00 00 02 00 91
	29 01 00 00 00 00 03 c5 19 50
29 01 00 00 00 00 02 00 00
	29 01 00 00 00 00 03 d8 bc bc
29 01 00 00 00 00 02 00 b0
	29 01 00 00 00 00 03 c5 04 b8
29 01 00 00 00 00 02 00 bb
	29 01 00 00 00 00 02 c5 80
29 01 00 00 00 00 02 00 00
	29 01 00 00 00 00 02 d0 40
29 01 00 00 00 00 02 00 00
	29 01 00 00 00 00 03 d1 00 00
29 01 00 00 00 00 02 00 00
	29 01 00 00 00 00  11 e1 05 0e 14 0e 06 11 0b 0a 00 05 0a 03 0e 15 10 05
29 01 00 00 00 00 02 00 00
	29 01 00 00 00 00  11 e2 05 0e 14 0e 06 0f 0d 0c 04 07 0e 0b 10 15 10 05
29 01 00 00 00 00 02 00 00
	29 01 00 00 00 00 02 d9 73
29 01 00 00 00 00 02 00 80
	29 01 00 00 00 00 0c cb 00 00 00 00 00 00 00 00 00 00 00
29 01 00 00 00 00 02 00 90
	29 01 00 00 00 00 10 cb 00 00 00 00 00 00 00 00 00 00 00 00 00 00 00
29 01 00 00 00 00 02 00 a0
	29 01 00 00 00 00 10 cb 00 00 00 00 00 00 00 00 00 00 00 00 00 00 00
29 01 00 00 00 00 02 00 b0
	29 01 00 00 00 00 10 cb 00 00 00 00 00 00 00 00 00 00 00 00 00 00 00
29 01 00 00 00 00 02 00 c0
	29 01 00 00 00 00 10 cb 05 05 05 05 05 05 00 00 00 00 00 00 00 00 00
29 01 00 00 00 00 02 00 d0
	29 01 00 00 00 00 10 cb 00 00 00 00 00 05 05 05 05 05 05 05 05 00 00
29 01 00 00 00 00 02 00 e0
	29 01 00 00 00 00 0f  cb 00 00 00 00 00 00 00 00 00 00 00 00 05 05
29 01 00 00 00 00 02 00 f0
	29 01 00 00 00 00 0c cb ff ff ff ff ff ff ff ff ff ff ff
29 01 00 00 00 00 02 00 80
	29 01 00 00 00 00 10 cc 0a 0c 0e 10 02 04 00 00 00 00 00 00 00 00 00
29 01 00 00 00 00 02 00 90
	29 01 00 00 00 00 10 cc 00 00 00 00 00 2e 2d 09 0b 0d 0f 01 03 00 00
29 01 00 00 00 00 02 00 a0
	29 01 00 00 00 00 0f cc 00 00 00 00 00 00 00 00 00 00 00 00 2e 2d
29 01 00 00 00 00 02 00 b0
	29 01 00 00 00 00 10 cc 0f 0d 0b 09 03 01 00 00 00 00 00 00 00 00 00
29 01 00 00 00 00 02 00 c0
	29 01 00 00 00 00 10 cc 00 00 00 00 00 2d 2e 10 0e 0c 0a 04 02 00 00
29 01 00 00 00 00 02 00 d0
	29 01 00 00 00 00 0f  cc 00 00 00 00 00 00 00 00 00 00 00 00 2d 2e
29 01 00 00 00 00 02 00 80
	29 01 00 00 00 00 0d ce 8d 03 00 8c 03 00 8b 03 00 8a 03 00
29 01 00 00 00 00 02 00 a0
    29 01 00 00 00 00 0f ce 38 0b 04 fc 00 10 10 38 0a 04 fd 00 10 10
29 01 00 00 00 00 02 00 b0
	29 01 00 00 00 00  0f ce 38 09 04 fe 00 10 10 38 08 04 ff 00 10 10
29 01 00 00 00 00 02 00 c0
	29 01 00 00 00 00  0f ce 38 07 05 00 00 10 10 38 06 05 01 00 10 10
29 01 00 00 00 00 02 00 d0
	29 01 00 00 00 00  0f ce 38 05 05 02 00 10 10 38 04 05 03 00 10 10
29 01 00 00 00 00 02 00 80
	29 01 00 00 00 00  0f cf 00 00 00 00 00 00 00 00 00 00 00 00 00 00
29 01 00 00 00 00 02 00 90
	29 01 00 00 00 00  0f cf 00 00 00 00 00 00 00 00 00 00 00 00 00 00
29 01 00 00 00 00 02 00 a0
	29 01 00 00 00 00  0f cf 00 00 00 00 00 00 00 00 00 00 00 00 00 00
29 01 00 00 00 00 02 00 b0
	29 01 00 00 00 00 0f cf 00 00 00 00 00 00 00 00 00 00 00 00 00 00
29 01 00 00 00 00 02 00 c0
	29 01 00 00 00 00 0c cf 01 01 20 20 00 00 01 02 00 00 08
29 01 00 00 00 00 02 00 b5
	29 01 00 00 00 00 07 c5 33 f1 ff 33 f1 ff
    /*ce +++ */
    29 01 00 00 00 00 02 00 a0
    29 01 00 00 00 00 0D D6 01 1a 01 1a 01 e6 01 b3 01 b3 01 b3 

    29 01 00 00 00 00 02 00 B0
    29 01 00 00 00 00 0D D6 01 b3 01 cd 01 cd 01 cd 01 cd 01 66 

    29 01 00 00 00 00 02 00 C0
    29 01 00 00 00 00 0D D6 66 11 11 9a 11 77 77 11 77 77 11 89 

    29 01 00 00 00 00 02 00 D0
    29 01 00 00 00 00 07 D6 89 11 89 89 11 44 

    29 01 00 00 00 00 02 00 E0
    29 01 00 00 00 00 0D D6 33 11 44 4d 11 3c 3c 11 3c 3c 11 44 

    29 01 00 00 00 00 02 00 F0
    29 01 00 00 00 00 07 D6 44 11 44 44 11 22 

    29 01 00 00 00 00 02 00 90             /*Clever CMD1 */
    29 01 00 00 00 00 02 d6 00 

    29 01 00 00 00 00 02 00 00             /*CE -80: Low; 90: Mid; B0: High; */
    29 01 00 00 00 00 02 55 93 

    29 01 00 00 00 00 02 00 00 
    /*ce --- */
29 01 00 00 00 00 02 00 00
	29 01 00 00 00 00 04 ff ff ff ff
    /*29 01 00 00 00 00 02 51 00
    29 01 00 00 00 00 02 53 2c*/
    29 01 00 00 00 00 02 55 93
					29 01 00 00 64 00 02 11 00
                    29 01 00 00 78 00 02 29 00];
		qcom,mdss-dsi-off-command = [29 01 00 00 32 00 02 28 00
					29 01 00 00 78 00 02 10 00];
		qcom,mdss-dsi-on-command-state = "dsi_lp_mode";
		qcom,mdss-dsi-off-command-state = "dsi_hs_mode";
		qcom,mdss-dsi-h-sync-pulse = <1>;
		qcom,mdss-dsi-traffic-mode = "burst_mode";
		qcom,mdss-dsi-bllp-eof-power-mode;
		qcom,mdss-dsi-bllp-power-mode;
		qcom,mdss-dsi-lane-0-state;
		qcom,mdss-dsi-lane-1-state;
		qcom,mdss-dsi-lane-2-state;
		qcom,mdss-dsi-lane-3-state;
		qcom,mdss-dsi-panel-timings = [7d 25 1d 00 37 33 22 27 1e 03 04 00];
        /*qcom,mdss-dsi-panel-timings = [83 1e 13 00 34 3a 18 22 24 03 04 a0];*/
		qcom,mdss-dsi-t-clk-post = <0x20>;
		qcom,mdss-dsi-t-clk-pre = <0x2c>;
		qcom,mdss-dsi-bl-min-level = <1>;
		qcom,mdss-dsi-bl-max-level = <255>;
		qcom,mdss-dsi-dma-trigger = "trigger_sw";
		qcom,mdss-dsi-mdp-trigger = "none";
		qcom,mdss-dsi-bl-pmic-control-type = "bl_ctrl_dcs";
		qcom,mdss-dsi-reset-sequence = <1 20>, <0 1>, <1 20>;
		qcom,mdss-pan-physical-width-dimension = <59>;
		qcom,mdss-pan-physical-height-dimension = <104>;

	};
};
