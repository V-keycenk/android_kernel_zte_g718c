/* Copyright (c) 2013, The Linux Foundation. All rights reserved.
 *
 * This program is free software; you can redistribute it and/or modify
 * it under the terms of the GNU General Public License version 2 and
 * only version 2 as published by the Free Software Foundation.
 *
 * This program is distributed in the hope that it will be useful,
 * but WITHOUT ANY WARRANTY; without even the implied warranty of
 * MERCHANTABILITY or FITNESS FOR A PARTICULAR PURPOSE.  See the
 * GNU General Public License for more details.
 */

/*---------------------------------------------------------------------------
 * This file is autogenerated file using gcdb parser. Please do not edit it.
 * Update input XML file to add a new entry or update variable in this file
 * VERSION = "1.0"
 *---------------------------------------------------------------------------*/
&mdss_mdp {
	dsi_otm1283a_auo_720p_vid: qcom,mdss_dsi_otm1283a_auo_720p_video {
		qcom,mdss-dsi-panel-name = "otm1283 auo 720p video mode dsi panel";
        qcom,cont-splash-enabled;
		qcom,mdss-dsi-panel-controller = <&mdss_dsi0>;
		qcom,mdss-dsi-panel-type = "dsi_video_mode";
		qcom,mdss-dsi-panel-destination = "display_1";
		qcom,mdss-dsi-panel-framerate = <60>;
		qcom,mdss-dsi-virtual-channel-id = <0>;
		qcom,mdss-dsi-stream = <0>;
		qcom,mdss-dsi-panel-width = <720>;
		qcom,mdss-dsi-panel-height = <1280>;
		qcom,mdss-dsi-h-front-porch = <170>;
		qcom,mdss-dsi-h-back-porch = <150>;
		qcom,mdss-dsi-h-pulse-width = <28>;
		qcom,mdss-dsi-h-sync-skew = <0>;
		qcom,mdss-dsi-v-back-porch = <32>;
		qcom,mdss-dsi-v-front-porch = <32>;
		qcom,mdss-dsi-v-pulse-width = <1>;
		qcom,mdss-dsi-h-left-border = <0>;
		qcom,mdss-dsi-h-right-border = <0>;
		qcom,mdss-dsi-v-top-border = <0>;
		qcom,mdss-dsi-v-bottom-border = <0>;
		qcom,mdss-dsi-bpp = <24>;
		qcom,mdss-dsi-underflow-color = <0xff>;
		qcom,mdss-dsi-border-color = <0>;
		qcom,mdss-dsi-on-command = [
            23 01 00 00 00 00 02 00 00
            29 01 00 00 00 00 04 FF 12 83 01
            23 01 00 00 00 00 02 00 80
            29 01 00 00 00 00 03 FF 12 83
            23 01 00 00 00 00 02 00 80
            29 01 00 00 00 00 0a C0 00 64 00 10 10 00 64 10 10
            23 01 00 00 00 00 02 00 90
            29 01 00 00 00 00 07 C0 00 5C 00 01 00 04
            23 01 00 00 00 00 02 00 A2
            29 01 00 00 00 00 04 C0 01 00 00
            23 01 00 00 00 00 02 00 B3
            29 01 00 00 00 00 03 C0 00 50
            23 01 00 00 00 00 02 00 81
            23 01 00 00 00 00 02 C1 55
            23 01 00 00 00 00 02 00 90
            23 01 00 00 00 00 02 C4 49
            23 01 00 00 00 00 02 00 A0
            29 01 00 00 00 00 0f C4 05 10 04 02 05 15 11 05 10 07 02 05 15 11
            23 01 00 00 00 00 02 00 B0
            29 01 00 00 00 00 03 C4 00 00
            23 01 00 00 00 00 02 00 91
            29 01 00 00 00 00 03 C5 29 50
            23 01 00 00 00 00 02 00 00
            29 01 00 00 00 00 03 D8 84 84
            23 01 00 00 00 00 02 00 00
            23 01 00 00 00 00 02 D9 28
            23 01 00 00 00 00 02 00 81
            23 01 00 00 00 00 02 C4 82
            23 01 00 00 00 00 02 00 B0
            29 01 00 00 00 00 03 C5 04 B8
            23 01 00 00 00 00 02 00 BB
            23 01 00 00 00 00 02 C5 80
            23 01 00 00 00 00 02 00 82
            23 01 00 00 00 00 02 C4 02
            23 01 00 00 00 00 02 00 C6
            23 01 00 00 00 00 02 B0 03
            23 01 00 00 00 00 02 00 00
            23 01 00 00 00 00 02 D0 40
            23 01 00 00 00 00 02 00 00
            29 01 00 00 00 00 03 D1 00 00
            23 01 00 00 00 00 02 00 80
            23 01 00 00 00 00 02 C4 00
            23 01 00 00 00 00 02 00 98
            23 01 00 00 00 00 02 C5 10
            23 01 00 00 00 00 02 00 81
            23 01 00 00 00 00 02 F5 15
            23 01 00 00 00 00 02 00 83
            23 01 00 00 00 00 02 F5 15
            23 01 00 00 00 00 02 00 85
            23 01 00 00 00 00 02 F5 15
            23 01 00 00 00 00 02 00 87
            23 01 00 00 00 00 02 F5 15
            23 01 00 00 00 00 02 00 89
            23 01 00 00 00 00 02 F5 15
            23 01 00 00 00 00 02 00 8B
            23 01 00 00 00 00 02 F5 15
            23 01 00 00 00 00 02 00 95
            23 01 00 00 00 00 02 F5 15
            23 01 00 00 00 00 02 00 97
            23 01 00 00 00 00 02 F5 15
            23 01 00 00 00 00 02 00 99
            23 01 00 00 00 00 02 F5 15
            23 01 00 00 00 00 02 00 A1
            23 01 00 00 00 00 02 F5 15
            23 01 00 00 00 00 02 00 A3
            23 01 00 00 00 00 02 F5 15
            23 01 00 00 00 00 02 00 A5
            23 01 00 00 00 00 02 F5 15
            23 01 00 00 00 00 02 00 A7
            23 01 00 00 00 00 02 F5 15
            23 01 00 00 00 00 02 00 AB
            23 01 00 00 00 00 02 F5 18
            23 01 00 00 00 00 02 00 94
            23 01 00 00 00 00 02 F5 02
            23 01 00 00 00 00 02 00 BA
            23 01 00 00 00 00 02 F5 03
            23 01 00 00 00 00 02 00 B1
            29 01 00 00 00 00 0e F5 15 00 00 00 00 00 00 00 00 02 15 08 15
            23 01 00 00 00 00 02 00 B4
            23 01 00 00 00 00 02 C5 C0
            23 01 00 00 00 00 02 00 90
            29 01 00 00 00 00 05 F5 02 11 02 11
            23 01 00 00 00 00 02 00 90
            23 01 00 00 00 00 02 C5 50
            23 01 00 00 00 00 02 00 94
            23 01 00 00 00 00 02 C5 66
            23 01 00 00 00 00 02 00 80
            29 01 00 00 00 00 0c CB 00 00 00 00 00 00 00 00 00 00 00
            23 01 00 00 00 00 02 00 90
            29 01 00 00 00 00 10 CB 00 00 00 00 00 00 00 00 00 00 00 FF 00 FF 00
            23 01 00 00 00 00 02 00 A0
            29 01 00 00 00 00 10 CB FF 00 FF 00 00 00 00 00 00 00 00 00 00 00 00
            23 01 00 00 00 00 02 00 B0
            29 01 00 00 00 00 10 CB 00 00 00 FF 00 FF 00 FF 00 FF 00 00 00 00 00
            23 01 00 00 00 00 02 00 C0
            29 01 00 00 00 00 10 CB 00 00 00 00 00 00 00 05 05 00 05 05 05 05 05
            23 01 00 00 00 00 02 00 D0
            29 01 00 00 00 00 10 CB 05 05 05 05 05 00 00 00 00 00 00 00 00 00 05
            23 01 00 00 00 00 02 00 E0
            29 01 00 00 00 00 0f CB 05 00 05 05 05 05 05 05 05 05 05 05 00 00
            23 01 00 00 00 00 02 00 F0
            29 01 00 00 00 00 0c CB FF FF FF FF FF FF FF FF FF FF FF
            23 01 00 00 00 00 02 00 80
            29 01 00 00 00 00 10 CC 00 00 00 00 00 00 00 05 07 00 0D 09 0F 0B 15
            23 01 00 00 00 00 02 00 90
            29 01 00 00 00 00 10 CC 11 17 13 01 03 00 00 00 00 00 00 00 00 00 06
            23 01 00 00 00 00 02 00 A0
            29 01 00 00 00 00 0f CC 08 00 0E 0A 10 0C 16 12 18 14 02 04 00 00
            23 01 00 00 00 00 02 00 B0
            29 01 00 00 00 00 10 CC 00 00 00 00 00 00 00 04 02 00 0C 10 0A 0E 18
            23 01 00 00 00 00 02 00 C0
            29 01 00 00 00 00 10 CC 14 16 12 08 06 00 00 00 00 00 00 00 00 00 03
            23 01 00 00 00 00 02 00 D0
            29 01 00 00 00 00 0f CC 01 00 0B 0F 09 0D 17 13 15 11 07 05 00 00
            23 01 00 00 00 00 02 00 80
            29 01 00 00 00 00 0d CE 87 03 28 86 03 28 85 03 28 84 03 28
            23 01 00 00 00 00 02 00 90
            29 01 00 00 00 00 0f CE 34 FC 28 34 FD 28 34 FE 28 34 FF 28 00 00
            23 01 00 00 00 00 02 00 A0
            29 01 00 00 00 00 0f CE 38 07 05 00 00 28 00 38 06 05 01 00 28 00
            23 01 00 00 00 00 02 00 B0
            29 01 00 00 00 00 0f CE 38 05 05 02 00 28 00 38 04 05 03 00 28 00
            23 01 00 00 00 00 02 00 C0
            29 01 00 00 00 00 0f CE 38 03 05 04 00 28 00 38 02 05 05 00 28 00
            23 01 00 00 00 00 02 00 D0
            29 01 00 00 00 00 0f CE 38 01 05 06 00 28 00 38 00 05 07 00 28 00
            23 01 00 00 00 00 02 00 80
            29 01 00 00 00 00 0f CF 38 07 05 00 00 18 25 38 06 05 01 00 18 25
            23 01 00 00 00 00 02 00 90
            29 01 00 00 00 00 0f CF 38 05 05 02 00 18 25 38 04 05 03 00 18 25
            23 01 00 00 00 00 02 00 A0
            29 01 00 00 00 00 0f CF 38 03 05 04 00 18 25 38 02 05 05 00 18 25
            23 01 00 00 00 00 02 00 B0
            29 01 00 00 00 00 0f CF 38 01 05 06 00 18 25 38 00 05 07 00 18 25
            23 01 00 00 00 00 02 00 C0
            29 01 00 00 00 00 0c CF 01 01 20 20 00 00 01 81 00 03 08
            23 01 00 00 00 00 02 00 00
            29 01 00 00 00 00 11 E1 10 0D 14 0F 08 12 0D 0C 02 06 0A 07 0F 12 0C 03
            23 01 00 00 00 00 02 00 00
            29 01 00 00 00 00 11 E2 02 0D 14 0F 08 12 0D 0C 02 06 0A 07 0F 12 0C 09
            
            /*ce +++ */
            23 01 00 00 00 00 02 00 a0
            29 01 00 00 00 00 0D D6 01 1a 01 1a 01 e6 01 b3 01 b3 01 b3 

            23 01 00 00 00 00 02 00 B0
            29 01 00 00 00 00 0D D6 01 b3 01 cd 01 cd 01 cd 01 cd 01 66 

            23 01 00 00 00 00 02 00 C0
            29 01 00 00 00 00 0D D6 66 11 11 9a 11 77 77 11 77 77 11 89 

            23 01 00 00 00 00 02 00 D0
            29 01 00 00 00 00 07 D6 89 11 89 89 11 44 

            23 01 00 00 00 00 02 00 E0
            29 01 00 00 00 00 0D D6 33 11 44 4d 11 3c 3c 11 3c 3c 11 44 

            23 01 00 00 00 00 02 00 F0
            29 01 00 00 00 00 07 D6 44 11 44 44 11 22 

            23 01 00 00 00 00 02 00 90             /*Clever CMD1 */
            23 01 00 00 00 00 02 d6 00 

            23 01 00 00 00 00 02 00 00             /*CE -80: Low; 90: Mid; B0: High; */
            23 01 00 00 00 00 02 55 93 

            23 01 00 00 00 00 02 00 00 
            /*ce --- */
    
            23 01 00 00 00 00 02 00 00
            29 01 00 00 00 00 04 FF FF FF FF
            /*23 01 00 00 00 00 02 51 00
            23 01 00 00 00 00 02 53 2c*/
            23 01 00 00 00 00 02 55 93
            05 01 00 00 64 00 02 11 00
            05 01 00 00 78 00 02 29 00];
		qcom,mdss-dsi-off-command = [05 01 00 00 32 00 02 28 00
					05 01 00 00 78 00 02 10 00];
		qcom,mdss-dsi-on-command-state = "dsi_lp_mode";
		qcom,mdss-dsi-off-command-state = "dsi_hs_mode";
		qcom,mdss-dsi-h-sync-pulse = <1>;
		qcom,mdss-dsi-traffic-mode = "burst_mode";
		qcom,mdss-dsi-bllp-eof-power-mode;
		qcom,mdss-dsi-bllp-power-mode;
		qcom,mdss-dsi-lane-0-state;
		qcom,mdss-dsi-lane-1-state;
		qcom,mdss-dsi-lane-2-state;
		qcom,mdss-dsi-lane-3-state;
		qcom,mdss-dsi-panel-timings = [7d 25 1d 00 37 33 22 27 1e 03 04 00];
        /*qcom,mdss-dsi-panel-timings = [83 1e 13 00 34 3a 18 22 24 03 04 a0];*/
		qcom,mdss-dsi-t-clk-post = <0x20>;
		qcom,mdss-dsi-t-clk-pre = <0x2c>;
		qcom,mdss-dsi-bl-min-level = <1>;
		qcom,mdss-dsi-bl-max-level = <255>;
		qcom,mdss-dsi-dma-trigger = "trigger_sw";
		qcom,mdss-dsi-mdp-trigger = "none";
		qcom,mdss-dsi-bl-pmic-control-type = "bl_ctrl_dcs";
		qcom,mdss-dsi-reset-sequence = <1 20>, <0 1>, <1 20>;
		qcom,mdss-pan-physical-width-dimension = <59>;
		qcom,mdss-pan-physical-height-dimension = <104>;

	};
};
