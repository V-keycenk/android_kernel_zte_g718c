/* Copyright (c) 2013, The Linux Foundation. All rights reserved.
 *
 * This program is free software; you can redistribute it and/or modify
 * it under the terms of the GNU General Public License version 2 and
 * only version 2 as published by the Free Software Foundation.
 *
 * This program is distributed in the hope that it will be useful,
 * but WITHOUT ANY WARRANTY; without even the implied warranty of
 * MERCHANTABILITY or FITNESS FOR A PARTICULAR PURPOSE.  See the
 * GNU General Public License for more details.
 */

/*---------------------------------------------------------------------------
 * This file is autogenerated file using gcdb parser. Please do not edit it.
 * Update input XML file to add a new entry or update variable in this file
 * VERSION = "1.0"
 *---------------------------------------------------------------------------*/
&mdss_mdp {
	dsi_nt35590_tianma_720p_vid: qcom,mdss_dsi_nt35590_tianma_720p_video {
		qcom,mdss-dsi-panel-name = "nt35590 tianma 720p cmd mode dsi panel";
        qcom,cont-splash-enabled;
		qcom,mdss-dsi-panel-controller = <&mdss_dsi0>;
		/*qcom,mdss-dsi-panel-type = "dsi_video_mode";*/
		qcom,mdss-dsi-panel-type = "dsi_cmd_mode";
		qcom,mdss-dsi-panel-destination = "display_1";
		qcom,mdss-dsi-panel-framerate = <60>;
		qcom,mdss-dsi-virtual-channel-id = <0>;
		qcom,mdss-dsi-stream = <0>;
		/*qcom,mdss-dsi-panel-width = <720>;
		qcom,mdss-dsi-panel-height = <1280>;
		qcom,mdss-dsi-h-front-porch = <170>;
		qcom,mdss-dsi-h-back-porch = <150>;
		qcom,mdss-dsi-h-pulse-width = <28>;
		qcom,mdss-dsi-h-sync-skew = <0>;
		qcom,mdss-dsi-v-back-porch = <32>;
		qcom,mdss-dsi-v-front-porch = <32>;
		qcom,mdss-dsi-v-pulse-width = <1>;*/
        qcom,mdss-dsi-panel-width = <720>;
		qcom,mdss-dsi-panel-height = <1280>;
		qcom,mdss-dsi-h-front-porch = <140>;
		qcom,mdss-dsi-h-back-porch = <164>;
		qcom,mdss-dsi-h-pulse-width = <8>;
		qcom,mdss-dsi-h-sync-skew = <0>;
		qcom,mdss-dsi-v-back-porch = <11>;
		qcom,mdss-dsi-v-front-porch = <6>;
		qcom,mdss-dsi-v-pulse-width = <1>;
        
		qcom,mdss-dsi-h-left-border = <0>;
		qcom,mdss-dsi-h-right-border = <0>;
		qcom,mdss-dsi-v-top-border = <0>;
		qcom,mdss-dsi-v-bottom-border = <0>;
		qcom,mdss-dsi-bpp = <24>;
		qcom,mdss-dsi-underflow-color = <0xff>;
		qcom,mdss-dsi-border-color = <0>;
		qcom,mdss-dsi-on-command = [
                    15 01 00 00 00 00 02 FF 00
                    15 01 00 00 00 00 02 FB 01
                    39 01 00 00 00 00 06 3B 03 06 03 02 02
                    15 01 00 00 00 00 02 FF 01
                    15 01 00 00 00 00 02 FB 01
                    15 01 00 00 00 00 02 00 3A
                    15 01 00 00 00 00 02 01 33
                    15 01 00 00 00 00 02 02 53
                    15 01 00 00 00 00 02 03 53
                    15 01 00 00 00 00 02 04 55
                    15 01 00 00 00 00 02 05 33
                    15 01 00 00 00 00 02 06 22
                    15 01 00 00 00 00 02 08 66
                    15 01 00 00 00 00 02 09 0F
                    15 01 00 00 00 00 02 0B C2
                    15 01 00 00 00 00 02 0C C2
                    15 01 00 00 00 00 02 0D 24
                    15 01 00 00 00 00 02 0E 33
                    15 01 00 00 00 00 02 11 9A
                    15 01 00 00 00 00 02 12 03
                    15 01 00 00 00 00 02 0F 0A
                    15 01 00 00 00 00 02 36 73
                    15 01 00 00 00 00 02 71 2C
                    15 01 00 00 00 00 02 FF 05
                    15 01 00 00 00 00 02 FB 01
                    15 01 00 00 00 00 02 01 00
                    15 01 00 00 00 00 02 02 8D
                    15 01 00 00 00 00 02 03 8D
                    15 01 00 00 00 00 02 04 8D
                    15 01 00 00 00 00 02 05 30
                    15 01 00 00 00 00 02 06 33
                    15 01 00 00 00 00 02 07 77
                    15 01 00 00 00 00 02 08 00
                    15 01 00 00 00 00 02 09 00
                    15 01 00 00 00 00 02 0A 00
                    15 01 00 00 00 00 02 0B 80
                    15 01 00 00 00 00 02 0C C8
                    15 01 00 00 00 00 02 0D 0A
                    15 01 00 00 00 00 02 0E 1B
                    15 01 00 00 00 00 02 0F 06
                    15 01 00 00 00 00 02 10 56
                    15 01 00 00 00 00 02 11 00
                    15 01 00 00 00 00 02 12 00
                    15 01 00 00 00 00 02 13 1E
                    15 01 00 00 00 00 02 14 00
                    15 01 00 00 00 00 02 15 1A
                    15 01 00 00 00 00 02 16 05
                    15 01 00 00 00 00 02 17 00
                    15 01 00 00 00 00 02 18 1E
                    15 01 00 00 00 00 02 19 FF
                    15 01 00 00 00 00 02 1A 00
                    15 01 00 00 00 00 02 1B FC
                    15 01 00 00 00 00 02 1C 80
                    15 01 00 00 00 00 02 1D 00
                    15 01 00 00 00 00 02 1E 00
                    15 01 00 00 00 00 02 1F 77
                    15 01 00 00 00 00 02 20 00
                    15 01 00 00 00 00 02 21 00
                    15 01 00 00 00 00 02 22 55
                    15 01 00 00 00 00 02 23 0D
                    15 01 00 00 00 00 02 31 A0
                    15 01 00 00 00 00 02 32 00
                    15 01 00 00 00 00 02 33 B8
                    15 01 00 00 00 00 02 34 BB
                    15 01 00 00 00 00 02 35 11
                    15 01 00 00 00 00 02 36 02
                    15 01 00 00 00 00 02 37 00
                    15 01 00 00 00 00 02 38 01
                    15 01 00 00 00 00 02 39 0B
                    15 01 00 00 00 00 02 44 08
                    15 01 00 00 00 00 02 45 80
                    15 01 00 00 00 00 02 46 CC
                    15 01 00 00 00 00 02 47 04
                    15 01 00 00 00 00 02 48 00
                    15 01 00 00 00 00 02 49 00
                    15 01 00 00 00 00 02 4A 01
                    15 01 00 00 00 00 02 6C 03
                    15 01 00 00 00 00 02 6D 03
                    15 01 00 00 00 00 02 6E 2F
                    15 01 00 00 00 00 02 43 00
                    15 01 00 00 00 00 02 4B 23
                    15 01 00 00 00 00 02 4C 01
                    15 01 00 00 00 00 02 50 23
                    15 01 00 00 00 00 02 51 01
                    15 01 00 00 00 00 02 58 23
                    15 01 00 00 00 00 02 59 01
                    15 01 00 00 00 00 02 5D 23
                    15 01 00 00 00 00 02 5E 01
                    15 01 00 00 00 00 02 89 00
                    15 01 00 00 00 00 02 8D 01
                    15 01 00 00 00 00 02 8E 64
                    15 01 00 00 00 00 02 8F 20
                    15 01 00 00 00 00 02 97 8E
                    15 01 00 00 00 00 02 82 8C
                    15 01 00 00 00 00 02 83 02
                    15 01 00 00 00 00 02 BB 0A
                    15 01 00 00 00 00 02 BC 0A
                    15 01 00 00 00 00 02 24 25
                    15 01 00 00 00 00 02 25 55
                    15 01 00 00 00 00 02 26 05
                    15 01 00 00 00 00 02 27 23
                    15 01 00 00 00 00 02 28 01
                    15 01 00 00 00 00 02 29 31
                    15 01 00 00 00 00 02 2A 5D
                    15 01 00 00 00 00 02 2B 01
                    15 01 00 00 00 00 02 2F 00
                    15 01 00 00 00 00 02 30 10
                    15 01 00 00 00 00 02 A7 12
                    15 01 00 00 00 00 02 2D 03
                    15 01 00 00 00 00 02 FF 01
                    15 01 00 00 00 00 02 75 01
                    15 01 00 00 00 00 02 76 53
                    15 01 00 00 00 00 02 77 01
                    15 01 00 00 00 00 02 78 57
                    15 01 00 00 00 00 02 79 01
                    15 01 00 00 00 00 02 7A 60
                    15 01 00 00 00 00 02 7B 01
                    15 01 00 00 00 00 02 7C 66
                    15 01 00 00 00 00 02 7D 01
                    15 01 00 00 00 00 02 7E 71
                    15 01 00 00 00 00 02 7F 01
                    15 01 00 00 00 00 02 80 73
                    15 01 00 00 00 00 02 81 01
                    15 01 00 00 00 00 02 82 7C
                    15 01 00 00 00 00 02 83 01
                    15 01 00 00 00 00 02 84 84
                    15 01 00 00 00 00 02 85 01
                    15 01 00 00 00 00 02 86 8B
                    15 01 00 00 00 00 02 87 01
                    15 01 00 00 00 00 02 88 A0
                    15 01 00 00 00 00 02 89 01
                    15 01 00 00 00 00 02 8A B8
                    15 01 00 00 00 00 02 8B 01
                    15 01 00 00 00 00 02 8C DB
                    15 01 00 00 00 00 02 8D 01
                    15 01 00 00 00 00 02 8E FD
                    15 01 00 00 00 00 02 8F 02
                    15 01 00 00 00 00 02 90 33
                    15 01 00 00 00 00 02 91 02
                    15 01 00 00 00 00 02 92 62
                    15 01 00 00 00 00 02 93 02
                    15 01 00 00 00 00 02 94 63
                    15 01 00 00 00 00 02 95 02
                    15 01 00 00 00 00 02 96 91
                    15 01 00 00 00 00 02 97 02
                    15 01 00 00 00 00 02 98 C6
                    15 01 00 00 00 00 02 99 02
                    15 01 00 00 00 00 02 9A E8
                    15 01 00 00 00 00 02 9B 03
                    15 01 00 00 00 00 02 9C 15
                    15 01 00 00 00 00 02 9D 03
                    15 01 00 00 00 00 02 9E 33
                    15 01 00 00 00 00 02 9F 03
                    15 01 00 00 00 00 02 A0 5B
                    15 01 00 00 00 00 02 A2 03
                    15 01 00 00 00 00 02 A3 65
                    15 01 00 00 00 00 02 A4 03
                    15 01 00 00 00 00 02 A5 71
                    15 01 00 00 00 00 02 A6 03
                    15 01 00 00 00 00 02 A7 7F
                    15 01 00 00 00 00 02 A9 03
                    15 01 00 00 00 00 02 AA 9B
                    15 01 00 00 00 00 02 AB 03
                    15 01 00 00 00 00 02 AC B7
                    15 01 00 00 00 00 02 AD 03
                    15 01 00 00 00 00 02 AE D3
                    15 01 00 00 00 00 02 AF 03
                    15 01 00 00 00 00 02 B0 F0
                    15 01 00 00 00 00 02 B1 03
                    15 01 00 00 00 00 02 B2 FF
                    15 01 00 00 00 00 02 B3 01
                    15 01 00 00 00 00 02 B4 53
                    15 01 00 00 00 00 02 B5 01
                    15 01 00 00 00 00 02 B6 57
                    15 01 00 00 00 00 02 B7 01
                    15 01 00 00 00 00 02 B8 60
                    15 01 00 00 00 00 02 B9 01
                    15 01 00 00 00 00 02 BA 66
                    15 01 00 00 00 00 02 BB 01
                    15 01 00 00 00 00 02 BC 71
                    15 01 00 00 00 00 02 BD 01
                    15 01 00 00 00 00 02 BE 73
                    15 01 00 00 00 00 02 BF 01
                    15 01 00 00 00 00 02 C0 7C
                    15 01 00 00 00 00 02 C1 01
                    15 01 00 00 00 00 02 C2 84
                    15 01 00 00 00 00 02 C3 01
                    15 01 00 00 00 00 02 C4 8B
                    15 01 00 00 00 00 02 C5 01
                    15 01 00 00 00 00 02 C6 A0
                    15 01 00 00 00 00 02 C7 01
                    15 01 00 00 00 00 02 C8 B8
                    15 01 00 00 00 00 02 C9 01
                    15 01 00 00 00 00 02 CA DB
                    15 01 00 00 00 00 02 CB 01
                    15 01 00 00 00 00 02 CC FD
                    15 01 00 00 00 00 02 CD 02
                    15 01 00 00 00 00 02 CE 33
                    15 01 00 00 00 00 02 CF 02
                    15 01 00 00 00 00 02 D0 62
                    15 01 00 00 00 00 02 D1 02
                    15 01 00 00 00 00 02 D2 63
                    15 01 00 00 00 00 02 D3 02
                    15 01 00 00 00 00 02 D4 91
                    15 01 00 00 00 00 02 D5 02
                    15 01 00 00 00 00 02 D6 C6
                    15 01 00 00 00 00 02 D7 02
                    15 01 00 00 00 00 02 D8 E8
                    15 01 00 00 00 00 02 D9 03
                    15 01 00 00 00 00 02 DA 15
                    15 01 00 00 00 00 02 DB 03
                    15 01 00 00 00 00 02 DC 33
                    15 01 00 00 00 00 02 DD 03
                    15 01 00 00 00 00 02 DE 5B
                    15 01 00 00 00 00 02 DF 03
                    15 01 00 00 00 00 02 E0 65
                    15 01 00 00 00 00 02 E1 03
                    15 01 00 00 00 00 02 E2 71
                    15 01 00 00 00 00 02 E3 03
                    15 01 00 00 00 00 02 E4 7F
                    15 01 00 00 00 00 02 E5 03
                    15 01 00 00 00 00 02 E6 9B
                    15 01 00 00 00 00 02 E7 03
                    15 01 00 00 00 00 02 E8 B7
                    15 01 00 00 00 00 02 E9 03
                    15 01 00 00 00 00 02 EA D3
                    15 01 00 00 00 00 02 EB 03
                    15 01 00 00 00 00 02 EC F0
                    15 01 00 00 00 00 02 ED 03
                    15 01 00 00 00 00 02 EE FF
                    15 01 00 00 00 00 02 EF 01
                    15 01 00 00 00 00 02 F0 69
                    15 01 00 00 00 00 02 F1 01
                    15 01 00 00 00 00 02 F2 6D
                    15 01 00 00 00 00 02 F3 01
                    15 01 00 00 00 00 02 F4 75
                    15 01 00 00 00 00 02 F5 01
                    15 01 00 00 00 00 02 F6 7A
                    15 01 00 00 00 00 02 F7 01
                    15 01 00 00 00 00 02 F8 84
                    15 01 00 00 00 00 02 F9 01
                    15 01 00 00 00 00 02 FA 86
                    15 01 00 00 00 00 02 FF 02
                    15 01 00 00 00 00 02 00 01
                    15 01 00 00 00 00 02 01 8E
                    15 01 00 00 00 00 02 02 01
                    15 01 00 00 00 00 02 03 95
                    15 01 00 00 00 00 02 04 01
                    15 01 00 00 00 00 02 05 9B
                    15 01 00 00 00 00 02 06 01
                    15 01 00 00 00 00 02 07 AE
                    15 01 00 00 00 00 02 08 01
                    15 01 00 00 00 00 02 09 C4
                    15 01 00 00 00 00 02 0A 01
                    15 01 00 00 00 00 02 0B E5
                    15 01 00 00 00 00 02 0C 02
                    15 01 00 00 00 00 02 0D 04
                    15 01 00 00 00 00 02 0E 02
                    15 01 00 00 00 00 02 0F 38
                    15 01 00 00 00 00 02 10 02
                    15 01 00 00 00 00 02 11 65
                    15 01 00 00 00 00 02 12 02
                    15 01 00 00 00 00 02 13 66
                    15 01 00 00 00 00 02 14 02
                    15 01 00 00 00 00 02 15 94
                    15 01 00 00 00 00 02 16 02
                    15 01 00 00 00 00 02 17 C7
                    15 01 00 00 00 00 02 18 02
                    15 01 00 00 00 00 02 19 E9
                    15 01 00 00 00 00 02 1A 03
                    15 01 00 00 00 00 02 1B 16
                    15 01 00 00 00 00 02 1C 03
                    15 01 00 00 00 00 02 1D 34
                    15 01 00 00 00 00 02 1E 03
                    15 01 00 00 00 00 02 1F 5B
                    15 01 00 00 00 00 02 20 03
                    15 01 00 00 00 00 02 21 65
                    15 01 00 00 00 00 02 22 03
                    15 01 00 00 00 00 02 23 72
                    15 01 00 00 00 00 02 24 03
                    15 01 00 00 00 00 02 25 80
                    15 01 00 00 00 00 02 26 03
                    15 01 00 00 00 00 02 27 9C
                    15 01 00 00 00 00 02 28 03
                    15 01 00 00 00 00 02 29 B8
                    15 01 00 00 00 00 02 2A 03
                    15 01 00 00 00 00 02 2B D4
                    15 01 00 00 00 00 02 2D 03
                    15 01 00 00 00 00 02 2F F0
                    15 01 00 00 00 00 02 30 03
                    15 01 00 00 00 00 02 31 FF
                    15 01 00 00 00 00 02 32 01
                    15 01 00 00 00 00 02 33 69
                    15 01 00 00 00 00 02 34 01
                    15 01 00 00 00 00 02 35 6D
                    15 01 00 00 00 00 02 36 01
                    15 01 00 00 00 00 02 37 75
                    15 01 00 00 00 00 02 38 01
                    15 01 00 00 00 00 02 39 7A
                    15 01 00 00 00 00 02 3A 01
                    15 01 00 00 00 00 02 3B 84
                    15 01 00 00 00 00 02 3D 01
                    15 01 00 00 00 00 02 3F 86
                    15 01 00 00 00 00 02 40 01
                    15 01 00 00 00 00 02 41 8E
                    15 01 00 00 00 00 02 42 01
                    15 01 00 00 00 00 02 43 95
                    15 01 00 00 00 00 02 44 01
                    15 01 00 00 00 00 02 45 9B
                    15 01 00 00 00 00 02 46 01
                    15 01 00 00 00 00 02 47 AE
                    15 01 00 00 00 00 02 48 01
                    15 01 00 00 00 00 02 49 C4
                    15 01 00 00 00 00 02 4A 01
                    15 01 00 00 00 00 02 4B E5
                    15 01 00 00 00 00 02 4C 02
                    15 01 00 00 00 00 02 4D 04
                    15 01 00 00 00 00 02 4E 02
                    15 01 00 00 00 00 02 4F 38
                    15 01 00 00 00 00 02 50 02
                    15 01 00 00 00 00 02 51 65
                    15 01 00 00 00 00 02 52 02
                    15 01 00 00 00 00 02 53 66
                    15 01 00 00 00 00 02 54 02
                    15 01 00 00 00 00 02 55 94
                    15 01 00 00 00 00 02 56 02
                    15 01 00 00 00 00 02 58 C7
                    15 01 00 00 00 00 02 59 02
                    15 01 00 00 00 00 02 5A E9
                    15 01 00 00 00 00 02 5B 03
                    15 01 00 00 00 00 02 5C 16
                    15 01 00 00 00 00 02 5D 03
                    15 01 00 00 00 00 02 5E 34
                    15 01 00 00 00 00 02 5F 03
                    15 01 00 00 00 00 02 60 5B
                    15 01 00 00 00 00 02 61 03
                    15 01 00 00 00 00 02 62 65
                    15 01 00 00 00 00 02 63 03
                    15 01 00 00 00 00 02 64 72
                    15 01 00 00 00 00 02 65 03
                    15 01 00 00 00 00 02 66 80
                    15 01 00 00 00 00 02 67 03
                    15 01 00 00 00 00 02 68 9C
                    15 01 00 00 00 00 02 69 03
                    15 01 00 00 00 00 02 6A B8
                    15 01 00 00 00 00 02 6B 03
                    15 01 00 00 00 00 02 6C D4
                    15 01 00 00 00 00 02 6D 03
                    15 01 00 00 00 00 02 6E F0
                    15 01 00 00 00 00 02 6F 03
                    15 01 00 00 00 00 02 70 FF
                    15 01 00 00 00 00 02 71 00
                    15 01 00 00 00 00 02 72 7C
                    15 01 00 00 00 00 02 73 00
                    15 01 00 00 00 00 02 74 95
                    15 01 00 00 00 00 02 75 00
                    15 01 00 00 00 00 02 76 B8
                    15 01 00 00 00 00 02 77 00
                    15 01 00 00 00 00 02 78 CB
                    15 01 00 00 00 00 02 79 00
                    15 01 00 00 00 00 02 7A E9
                    15 01 00 00 00 00 02 7B 00
                    15 01 00 00 00 00 02 7C EE
                    15 01 00 00 00 00 02 7D 01
                    15 01 00 00 00 00 02 7E 03
                    15 01 00 00 00 00 02 7F 01
                    15 01 00 00 00 00 02 80 13
                    15 01 00 00 00 00 02 81 01
                    15 01 00 00 00 00 02 82 21
                    15 01 00 00 00 00 02 83 01
                    15 01 00 00 00 00 02 84 47
                    15 01 00 00 00 00 02 85 01
                    15 01 00 00 00 00 02 86 6E
                    15 01 00 00 00 00 02 87 01
                    15 01 00 00 00 00 02 88 A2
                    15 01 00 00 00 00 02 89 01
                    15 01 00 00 00 00 02 8A D0
                    15 01 00 00 00 00 02 8B 02
                    15 01 00 00 00 00 02 8C 15
                    15 01 00 00 00 00 02 8D 02
                    15 01 00 00 00 00 02 8E 4C
                    15 01 00 00 00 00 02 8F 02
                    15 01 00 00 00 00 02 90 4D
                    15 01 00 00 00 00 02 91 02
                    15 01 00 00 00 00 02 92 81
                    15 01 00 00 00 00 02 93 02
                    15 01 00 00 00 00 02 94 B8
                    15 01 00 00 00 00 02 95 02
                    15 01 00 00 00 00 02 96 DB
                    15 01 00 00 00 00 02 97 03
                    15 01 00 00 00 00 02 98 0A
                    15 01 00 00 00 00 02 99 03
                    15 01 00 00 00 00 02 9A 2B
                    15 01 00 00 00 00 02 9B 03
                    15 01 00 00 00 00 02 9C 5B
                    15 01 00 00 00 00 02 9D 03
                    15 01 00 00 00 00 02 9E 6C
                    15 01 00 00 00 00 02 9F 03
                    15 01 00 00 00 00 02 A0 84
                    15 01 00 00 00 00 02 A2 03
                    15 01 00 00 00 00 02 A3 B2
                    15 01 00 00 00 00 02 A4 03
                    15 01 00 00 00 00 02 A5 C3
                    15 01 00 00 00 00 02 A6 03
                    15 01 00 00 00 00 02 A7 D4
                    15 01 00 00 00 00 02 A9 03
                    15 01 00 00 00 00 02 AA E5
                    15 01 00 00 00 00 02 AB 03
                    15 01 00 00 00 00 02 AC F6
                    15 01 00 00 00 00 02 AD 03
                    15 01 00 00 00 00 02 AE FF
                    15 01 00 00 00 00 02 AF 00
                    15 01 00 00 00 00 02 B0 7C
                    15 01 00 00 00 00 02 B1 00
                    15 01 00 00 00 00 02 B2 95
                    15 01 00 00 00 00 02 B3 00
                    15 01 00 00 00 00 02 B4 B8
                    15 01 00 00 00 00 02 B5 00
                    15 01 00 00 00 00 02 B6 CB
                    15 01 00 00 00 00 02 B7 00
                    15 01 00 00 00 00 02 B8 E9
                    15 01 00 00 00 00 02 B9 00
                    15 01 00 00 00 00 02 BA EE
                    15 01 00 00 00 00 02 BB 01
                    15 01 00 00 00 00 02 BC 03
                    15 01 00 00 00 00 02 BD 01
                    15 01 00 00 00 00 02 BE 13
                    15 01 00 00 00 00 02 BF 01
                    15 01 00 00 00 00 02 C0 21
                    15 01 00 00 00 00 02 C1 01
                    15 01 00 00 00 00 02 C2 47
                    15 01 00 00 00 00 02 C3 01
                    15 01 00 00 00 00 02 C4 6E
                    15 01 00 00 00 00 02 C5 01
                    15 01 00 00 00 00 02 C6 A2
                    15 01 00 00 00 00 02 C7 01
                    15 01 00 00 00 00 02 C8 D0
                    15 01 00 00 00 00 02 C9 02
                    15 01 00 00 00 00 02 CA 15
                    15 01 00 00 00 00 02 CB 02
                    15 01 00 00 00 00 02 CC 4C
                    15 01 00 00 00 00 02 CD 02
                    15 01 00 00 00 00 02 CE 4D
                    15 01 00 00 00 00 02 CF 02
                    15 01 00 00 00 00 02 D0 81
                    15 01 00 00 00 00 02 D1 02
                    15 01 00 00 00 00 02 D2 B8
                    15 01 00 00 00 00 02 D3 02
                    15 01 00 00 00 00 02 D4 DB
                    15 01 00 00 00 00 02 D5 03
                    15 01 00 00 00 00 02 D6 0A
                    15 01 00 00 00 00 02 D7 03
                    15 01 00 00 00 00 02 D8 2B
                    15 01 00 00 00 00 02 D9 03
                    15 01 00 00 00 00 02 DA 5B
                    15 01 00 00 00 00 02 DB 03
                    15 01 00 00 00 00 02 DC 6C
                    15 01 00 00 00 00 02 DD 03
                    15 01 00 00 00 00 02 DE 84
                    15 01 00 00 00 00 02 DF 03
                    15 01 00 00 00 00 02 E0 B2
                    15 01 00 00 00 00 02 E1 03
                    15 01 00 00 00 00 02 E2 C3
                    15 01 00 00 00 00 02 E3 03
                    15 01 00 00 00 00 02 E4 D4
                    15 01 00 00 00 00 02 E5 03
                    15 01 00 00 00 00 02 E6 E5
                    15 01 00 00 00 00 02 E7 03
                    15 01 00 00 00 00 02 E8 F6
                    15 01 00 00 00 00 02 E9 03
                    15 01 00 00 00 00 02 EA FF
                    15 01 00 00 00 00 02 FF 00
                    15 01 00 00 00 00 02 FB 01
                    /*15 01 00 00 00 00 02 C2 03*/ /*video mode*/
                    15 01 00 00 00 00 02 C2 08 /*command mode */
                    15 01 00 00 00 00 02 BA 03
                    /* ce start */
                    15 01 00 00 00 00 02 FF 03
                    15 01 00 00 00 00 02 FB 01
                    15 01 00 00 00 00 02 18 00
                    15 01 00 00 00 00 02 19 00
                    15 01 00 00 00 00 02 1A 00
                    15 01 00 00 00 00 02 25 46
                    15 01 00 00 00 00 02 00 00
                    15 01 00 00 00 00 02 01 04
                    15 01 00 00 00 00 02 02 08
                    15 01 00 00 00 00 02 03 0C
                    15 01 00 00 00 00 02 04 10
                    15 01 00 00 00 00 02 05 14
                    15 01 00 00 00 00 02 06 18
                    15 01 00 00 00 00 02 07 1C
                    15 01 00 00 00 00 02 08 1C
                    15 01 00 00 00 00 02 09 18
                    15 01 00 00 00 00 02 0A 14
                    15 01 00 00 00 00 02 0B 10
                    15 01 00 00 00 00 02 0C 0C
                    15 01 00 00 00 00 02 0D 08
                    15 01 00 00 00 00 02 0E 04
                    15 01 00 00 00 00 02 0F 00
                    15 01 00 00 00 00 02 1B 2F
                    15 01 00 00 00 00 02 1C 00
                    15 01 00 00 00 00 02 1D 01
                    15 01 00 00 00 00 02 1E 02
                    15 01 00 00 00 00 02 1F 01
                    15 01 00 00 00 00 02 20 00
                    15 01 00 00 00 00 02 21 00
                    15 01 00 00 00 00 02 FF 00
                    /* ce end */

                    /*for pwm frequency 10.7KHZ */
                    15 01 00 00 00 00 02 FF 04
                    15 01 00 00 00 00 02 FB 01
                    15 01 00 00 00 00 02 0A 08
                    15 01 00 00 00 00 02 FF 00
                    15 01 00 00 00 00 02 FB 01
                    
                    /*15 01 00 00 00 00 02 51 FF
                    15 01 00 00 00 00 02 53 2C*/
                    15 01 00 00 00 00 02 55 91
					15 01 00 00 64 00 02 11 00
                    15 01 00 00 78 00 02 29 00];
        qcom,mdss-dsi-on-otp-command = [
                    15 01 00 00 00 00 02 FF 00
                    15 01 00 00 00 00 02 FB 01
                    39 01 00 00 00 00 06 3B 03 06 03 02 02
                    /*15 01 00 00 00 00 02 FF 01
                    15 01 00 00 00 00 02 FB 01
                    15 01 00 00 00 00 02 00 3A
                    15 01 00 00 00 00 02 01 33
                    15 01 00 00 00 00 02 02 53
                    15 01 00 00 00 00 02 03 53
                    15 01 00 00 00 00 02 04 55
                    15 01 00 00 00 00 02 05 33
                    15 01 00 00 00 00 02 06 22
                    15 01 00 00 00 00 02 08 66
                    15 01 00 00 00 00 02 09 0F
                    15 01 00 00 00 00 02 0B C2
                    15 01 00 00 00 00 02 0C C2
                    15 01 00 00 00 00 02 0D 24
                    15 01 00 00 00 00 02 0E 33
                    15 01 00 00 00 00 02 11 9A
                    15 01 00 00 00 00 02 12 03
                    15 01 00 00 00 00 02 0F 0A
                    15 01 00 00 00 00 02 36 73
                    15 01 00 00 00 00 02 71 2C
                    15 01 00 00 00 00 02 FF 05
                    15 01 00 00 00 00 02 FB 01
                    15 01 00 00 00 00 02 01 00
                    15 01 00 00 00 00 02 02 8D
                    15 01 00 00 00 00 02 03 8D
                    15 01 00 00 00 00 02 04 8D
                    15 01 00 00 00 00 02 05 30
                    15 01 00 00 00 00 02 06 33
                    15 01 00 00 00 00 02 07 77
                    15 01 00 00 00 00 02 08 00
                    15 01 00 00 00 00 02 09 00
                    15 01 00 00 00 00 02 0A 00
                    15 01 00 00 00 00 02 0B 80
                    15 01 00 00 00 00 02 0C C8
                    15 01 00 00 00 00 02 0D 0A
                    15 01 00 00 00 00 02 0E 1B
                    15 01 00 00 00 00 02 0F 06
                    15 01 00 00 00 00 02 10 56
                    15 01 00 00 00 00 02 11 00
                    15 01 00 00 00 00 02 12 00
                    15 01 00 00 00 00 02 13 1E
                    15 01 00 00 00 00 02 14 00
                    15 01 00 00 00 00 02 15 1A
                    15 01 00 00 00 00 02 16 05
                    15 01 00 00 00 00 02 17 00
                    15 01 00 00 00 00 02 18 1E
                    15 01 00 00 00 00 02 19 FF
                    15 01 00 00 00 00 02 1A 00
                    15 01 00 00 00 00 02 1B FC
                    15 01 00 00 00 00 02 1C 80
                    15 01 00 00 00 00 02 1D 00
                    15 01 00 00 00 00 02 1E 00
                    15 01 00 00 00 00 02 1F 77
                    15 01 00 00 00 00 02 20 00
                    15 01 00 00 00 00 02 21 00
                    15 01 00 00 00 00 02 22 55
                    15 01 00 00 00 00 02 23 0D
                    15 01 00 00 00 00 02 31 A0
                    15 01 00 00 00 00 02 32 00
                    15 01 00 00 00 00 02 33 B8
                    15 01 00 00 00 00 02 34 BB
                    15 01 00 00 00 00 02 35 11
                    15 01 00 00 00 00 02 36 02
                    15 01 00 00 00 00 02 37 00
                    15 01 00 00 00 00 02 38 01
                    15 01 00 00 00 00 02 39 0B
                    15 01 00 00 00 00 02 44 08
                    15 01 00 00 00 00 02 45 80
                    15 01 00 00 00 00 02 46 CC
                    15 01 00 00 00 00 02 47 04
                    15 01 00 00 00 00 02 48 00
                    15 01 00 00 00 00 02 49 00
                    15 01 00 00 00 00 02 4A 01
                    15 01 00 00 00 00 02 6C 03
                    15 01 00 00 00 00 02 6D 03
                    15 01 00 00 00 00 02 6E 2F
                    15 01 00 00 00 00 02 43 00
                    15 01 00 00 00 00 02 4B 23
                    15 01 00 00 00 00 02 4C 01
                    15 01 00 00 00 00 02 50 23
                    15 01 00 00 00 00 02 51 01
                    15 01 00 00 00 00 02 58 23
                    15 01 00 00 00 00 02 59 01
                    15 01 00 00 00 00 02 5D 23
                    15 01 00 00 00 00 02 5E 01
                    15 01 00 00 00 00 02 89 00
                    15 01 00 00 00 00 02 8D 01
                    15 01 00 00 00 00 02 8E 64
                    15 01 00 00 00 00 02 8F 20
                    15 01 00 00 00 00 02 97 8E
                    15 01 00 00 00 00 02 82 8C
                    15 01 00 00 00 00 02 83 02
                    15 01 00 00 00 00 02 BB 0A
                    15 01 00 00 00 00 02 BC 0A
                    15 01 00 00 00 00 02 24 25
                    15 01 00 00 00 00 02 25 55
                    15 01 00 00 00 00 02 26 05
                    15 01 00 00 00 00 02 27 23
                    15 01 00 00 00 00 02 28 01
                    15 01 00 00 00 00 02 29 31
                    15 01 00 00 00 00 02 2A 5D
                    15 01 00 00 00 00 02 2B 01
                    15 01 00 00 00 00 02 2F 00
                    15 01 00 00 00 00 02 30 10
                    15 01 00 00 00 00 02 A7 12
                    15 01 00 00 00 00 02 2D 03
                    15 01 00 00 00 00 02 FF 01
                    15 01 00 00 00 00 02 75 01
                    15 01 00 00 00 00 02 76 53
                    15 01 00 00 00 00 02 77 01
                    15 01 00 00 00 00 02 78 57
                    15 01 00 00 00 00 02 79 01
                    15 01 00 00 00 00 02 7A 60
                    15 01 00 00 00 00 02 7B 01
                    15 01 00 00 00 00 02 7C 66
                    15 01 00 00 00 00 02 7D 01
                    15 01 00 00 00 00 02 7E 71
                    15 01 00 00 00 00 02 7F 01
                    15 01 00 00 00 00 02 80 73
                    15 01 00 00 00 00 02 81 01
                    15 01 00 00 00 00 02 82 7C
                    15 01 00 00 00 00 02 83 01
                    15 01 00 00 00 00 02 84 84
                    15 01 00 00 00 00 02 85 01
                    15 01 00 00 00 00 02 86 8B
                    15 01 00 00 00 00 02 87 01
                    15 01 00 00 00 00 02 88 A0
                    15 01 00 00 00 00 02 89 01
                    15 01 00 00 00 00 02 8A B8
                    15 01 00 00 00 00 02 8B 01
                    15 01 00 00 00 00 02 8C DB
                    15 01 00 00 00 00 02 8D 01
                    15 01 00 00 00 00 02 8E FD
                    15 01 00 00 00 00 02 8F 02
                    15 01 00 00 00 00 02 90 33
                    15 01 00 00 00 00 02 91 02
                    15 01 00 00 00 00 02 92 62
                    15 01 00 00 00 00 02 93 02
                    15 01 00 00 00 00 02 94 63
                    15 01 00 00 00 00 02 95 02
                    15 01 00 00 00 00 02 96 91
                    15 01 00 00 00 00 02 97 02
                    15 01 00 00 00 00 02 98 C6
                    15 01 00 00 00 00 02 99 02
                    15 01 00 00 00 00 02 9A E8
                    15 01 00 00 00 00 02 9B 03
                    15 01 00 00 00 00 02 9C 15
                    15 01 00 00 00 00 02 9D 03
                    15 01 00 00 00 00 02 9E 33
                    15 01 00 00 00 00 02 9F 03
                    15 01 00 00 00 00 02 A0 5B
                    15 01 00 00 00 00 02 A2 03
                    15 01 00 00 00 00 02 A3 65
                    15 01 00 00 00 00 02 A4 03
                    15 01 00 00 00 00 02 A5 71
                    15 01 00 00 00 00 02 A6 03
                    15 01 00 00 00 00 02 A7 7F
                    15 01 00 00 00 00 02 A9 03
                    15 01 00 00 00 00 02 AA 9B
                    15 01 00 00 00 00 02 AB 03
                    15 01 00 00 00 00 02 AC B7
                    15 01 00 00 00 00 02 AD 03
                    15 01 00 00 00 00 02 AE D3
                    15 01 00 00 00 00 02 AF 03
                    15 01 00 00 00 00 02 B0 F0
                    15 01 00 00 00 00 02 B1 03
                    15 01 00 00 00 00 02 B2 FF
                    15 01 00 00 00 00 02 B3 01
                    15 01 00 00 00 00 02 B4 53
                    15 01 00 00 00 00 02 B5 01
                    15 01 00 00 00 00 02 B6 57
                    15 01 00 00 00 00 02 B7 01
                    15 01 00 00 00 00 02 B8 60
                    15 01 00 00 00 00 02 B9 01
                    15 01 00 00 00 00 02 BA 66
                    15 01 00 00 00 00 02 BB 01
                    15 01 00 00 00 00 02 BC 71
                    15 01 00 00 00 00 02 BD 01
                    15 01 00 00 00 00 02 BE 73
                    15 01 00 00 00 00 02 BF 01
                    15 01 00 00 00 00 02 C0 7C
                    15 01 00 00 00 00 02 C1 01
                    15 01 00 00 00 00 02 C2 84
                    15 01 00 00 00 00 02 C3 01
                    15 01 00 00 00 00 02 C4 8B
                    15 01 00 00 00 00 02 C5 01
                    15 01 00 00 00 00 02 C6 A0
                    15 01 00 00 00 00 02 C7 01
                    15 01 00 00 00 00 02 C8 B8
                    15 01 00 00 00 00 02 C9 01
                    15 01 00 00 00 00 02 CA DB
                    15 01 00 00 00 00 02 CB 01
                    15 01 00 00 00 00 02 CC FD
                    15 01 00 00 00 00 02 CD 02
                    15 01 00 00 00 00 02 CE 33
                    15 01 00 00 00 00 02 CF 02
                    15 01 00 00 00 00 02 D0 62
                    15 01 00 00 00 00 02 D1 02
                    15 01 00 00 00 00 02 D2 63
                    15 01 00 00 00 00 02 D3 02
                    15 01 00 00 00 00 02 D4 91
                    15 01 00 00 00 00 02 D5 02
                    15 01 00 00 00 00 02 D6 C6
                    15 01 00 00 00 00 02 D7 02
                    15 01 00 00 00 00 02 D8 E8
                    15 01 00 00 00 00 02 D9 03
                    15 01 00 00 00 00 02 DA 15
                    15 01 00 00 00 00 02 DB 03
                    15 01 00 00 00 00 02 DC 33
                    15 01 00 00 00 00 02 DD 03
                    15 01 00 00 00 00 02 DE 5B
                    15 01 00 00 00 00 02 DF 03
                    15 01 00 00 00 00 02 E0 65
                    15 01 00 00 00 00 02 E1 03
                    15 01 00 00 00 00 02 E2 71
                    15 01 00 00 00 00 02 E3 03
                    15 01 00 00 00 00 02 E4 7F
                    15 01 00 00 00 00 02 E5 03
                    15 01 00 00 00 00 02 E6 9B
                    15 01 00 00 00 00 02 E7 03
                    15 01 00 00 00 00 02 E8 B7
                    15 01 00 00 00 00 02 E9 03
                    15 01 00 00 00 00 02 EA D3
                    15 01 00 00 00 00 02 EB 03
                    15 01 00 00 00 00 02 EC F0
                    15 01 00 00 00 00 02 ED 03
                    15 01 00 00 00 00 02 EE FF
                    15 01 00 00 00 00 02 EF 01
                    15 01 00 00 00 00 02 F0 69
                    15 01 00 00 00 00 02 F1 01
                    15 01 00 00 00 00 02 F2 6D
                    15 01 00 00 00 00 02 F3 01
                    15 01 00 00 00 00 02 F4 75
                    15 01 00 00 00 00 02 F5 01
                    15 01 00 00 00 00 02 F6 7A
                    15 01 00 00 00 00 02 F7 01
                    15 01 00 00 00 00 02 F8 84
                    15 01 00 00 00 00 02 F9 01
                    15 01 00 00 00 00 02 FA 86
                    15 01 00 00 00 00 02 FF 02
                    15 01 00 00 00 00 02 00 01
                    15 01 00 00 00 00 02 01 8E
                    15 01 00 00 00 00 02 02 01
                    15 01 00 00 00 00 02 03 95
                    15 01 00 00 00 00 02 04 01
                    15 01 00 00 00 00 02 05 9B
                    15 01 00 00 00 00 02 06 01
                    15 01 00 00 00 00 02 07 AE
                    15 01 00 00 00 00 02 08 01
                    15 01 00 00 00 00 02 09 C4
                    15 01 00 00 00 00 02 0A 01
                    15 01 00 00 00 00 02 0B E5
                    15 01 00 00 00 00 02 0C 02
                    15 01 00 00 00 00 02 0D 04
                    15 01 00 00 00 00 02 0E 02
                    15 01 00 00 00 00 02 0F 38
                    15 01 00 00 00 00 02 10 02
                    15 01 00 00 00 00 02 11 65
                    15 01 00 00 00 00 02 12 02
                    15 01 00 00 00 00 02 13 66
                    15 01 00 00 00 00 02 14 02
                    15 01 00 00 00 00 02 15 94
                    15 01 00 00 00 00 02 16 02
                    15 01 00 00 00 00 02 17 C7
                    15 01 00 00 00 00 02 18 02
                    15 01 00 00 00 00 02 19 E9
                    15 01 00 00 00 00 02 1A 03
                    15 01 00 00 00 00 02 1B 16
                    15 01 00 00 00 00 02 1C 03
                    15 01 00 00 00 00 02 1D 34
                    15 01 00 00 00 00 02 1E 03
                    15 01 00 00 00 00 02 1F 5B
                    15 01 00 00 00 00 02 20 03
                    15 01 00 00 00 00 02 21 65
                    15 01 00 00 00 00 02 22 03
                    15 01 00 00 00 00 02 23 72
                    15 01 00 00 00 00 02 24 03
                    15 01 00 00 00 00 02 25 80
                    15 01 00 00 00 00 02 26 03
                    15 01 00 00 00 00 02 27 9C
                    15 01 00 00 00 00 02 28 03
                    15 01 00 00 00 00 02 29 B8
                    15 01 00 00 00 00 02 2A 03
                    15 01 00 00 00 00 02 2B D4
                    15 01 00 00 00 00 02 2D 03
                    15 01 00 00 00 00 02 2F F0
                    15 01 00 00 00 00 02 30 03
                    15 01 00 00 00 00 02 31 FF
                    15 01 00 00 00 00 02 32 01
                    15 01 00 00 00 00 02 33 69
                    15 01 00 00 00 00 02 34 01
                    15 01 00 00 00 00 02 35 6D
                    15 01 00 00 00 00 02 36 01
                    15 01 00 00 00 00 02 37 75
                    15 01 00 00 00 00 02 38 01
                    15 01 00 00 00 00 02 39 7A
                    15 01 00 00 00 00 02 3A 01
                    15 01 00 00 00 00 02 3B 84
                    15 01 00 00 00 00 02 3D 01
                    15 01 00 00 00 00 02 3F 86
                    15 01 00 00 00 00 02 40 01
                    15 01 00 00 00 00 02 41 8E
                    15 01 00 00 00 00 02 42 01
                    15 01 00 00 00 00 02 43 95
                    15 01 00 00 00 00 02 44 01
                    15 01 00 00 00 00 02 45 9B
                    15 01 00 00 00 00 02 46 01
                    15 01 00 00 00 00 02 47 AE
                    15 01 00 00 00 00 02 48 01
                    15 01 00 00 00 00 02 49 C4
                    15 01 00 00 00 00 02 4A 01
                    15 01 00 00 00 00 02 4B E5
                    15 01 00 00 00 00 02 4C 02
                    15 01 00 00 00 00 02 4D 04
                    15 01 00 00 00 00 02 4E 02
                    15 01 00 00 00 00 02 4F 38
                    15 01 00 00 00 00 02 50 02
                    15 01 00 00 00 00 02 51 65
                    15 01 00 00 00 00 02 52 02
                    15 01 00 00 00 00 02 53 66
                    15 01 00 00 00 00 02 54 02
                    15 01 00 00 00 00 02 55 94
                    15 01 00 00 00 00 02 56 02
                    15 01 00 00 00 00 02 58 C7
                    15 01 00 00 00 00 02 59 02
                    15 01 00 00 00 00 02 5A E9
                    15 01 00 00 00 00 02 5B 03
                    15 01 00 00 00 00 02 5C 16
                    15 01 00 00 00 00 02 5D 03
                    15 01 00 00 00 00 02 5E 34
                    15 01 00 00 00 00 02 5F 03
                    15 01 00 00 00 00 02 60 5B
                    15 01 00 00 00 00 02 61 03
                    15 01 00 00 00 00 02 62 65
                    15 01 00 00 00 00 02 63 03
                    15 01 00 00 00 00 02 64 72
                    15 01 00 00 00 00 02 65 03
                    15 01 00 00 00 00 02 66 80
                    15 01 00 00 00 00 02 67 03
                    15 01 00 00 00 00 02 68 9C
                    15 01 00 00 00 00 02 69 03
                    15 01 00 00 00 00 02 6A B8
                    15 01 00 00 00 00 02 6B 03
                    15 01 00 00 00 00 02 6C D4
                    15 01 00 00 00 00 02 6D 03
                    15 01 00 00 00 00 02 6E F0
                    15 01 00 00 00 00 02 6F 03
                    15 01 00 00 00 00 02 70 FF
                    15 01 00 00 00 00 02 71 00
                    15 01 00 00 00 00 02 72 7C
                    15 01 00 00 00 00 02 73 00
                    15 01 00 00 00 00 02 74 95
                    15 01 00 00 00 00 02 75 00
                    15 01 00 00 00 00 02 76 B8
                    15 01 00 00 00 00 02 77 00
                    15 01 00 00 00 00 02 78 CB
                    15 01 00 00 00 00 02 79 00
                    15 01 00 00 00 00 02 7A E9
                    15 01 00 00 00 00 02 7B 00
                    15 01 00 00 00 00 02 7C EE
                    15 01 00 00 00 00 02 7D 01
                    15 01 00 00 00 00 02 7E 03
                    15 01 00 00 00 00 02 7F 01
                    15 01 00 00 00 00 02 80 13
                    15 01 00 00 00 00 02 81 01
                    15 01 00 00 00 00 02 82 21
                    15 01 00 00 00 00 02 83 01
                    15 01 00 00 00 00 02 84 47
                    15 01 00 00 00 00 02 85 01
                    15 01 00 00 00 00 02 86 6E
                    15 01 00 00 00 00 02 87 01
                    15 01 00 00 00 00 02 88 A2
                    15 01 00 00 00 00 02 89 01
                    15 01 00 00 00 00 02 8A D0
                    15 01 00 00 00 00 02 8B 02
                    15 01 00 00 00 00 02 8C 15
                    15 01 00 00 00 00 02 8D 02
                    15 01 00 00 00 00 02 8E 4C
                    15 01 00 00 00 00 02 8F 02
                    15 01 00 00 00 00 02 90 4D
                    15 01 00 00 00 00 02 91 02
                    15 01 00 00 00 00 02 92 81
                    15 01 00 00 00 00 02 93 02
                    15 01 00 00 00 00 02 94 B8
                    15 01 00 00 00 00 02 95 02
                    15 01 00 00 00 00 02 96 DB
                    15 01 00 00 00 00 02 97 03
                    15 01 00 00 00 00 02 98 0A
                    15 01 00 00 00 00 02 99 03
                    15 01 00 00 00 00 02 9A 2B
                    15 01 00 00 00 00 02 9B 03
                    15 01 00 00 00 00 02 9C 5B
                    15 01 00 00 00 00 02 9D 03
                    15 01 00 00 00 00 02 9E 6C
                    15 01 00 00 00 00 02 9F 03
                    15 01 00 00 00 00 02 A0 84
                    15 01 00 00 00 00 02 A2 03
                    15 01 00 00 00 00 02 A3 B2
                    15 01 00 00 00 00 02 A4 03
                    15 01 00 00 00 00 02 A5 C3
                    15 01 00 00 00 00 02 A6 03
                    15 01 00 00 00 00 02 A7 D4
                    15 01 00 00 00 00 02 A9 03
                    15 01 00 00 00 00 02 AA E5
                    15 01 00 00 00 00 02 AB 03
                    15 01 00 00 00 00 02 AC F6
                    15 01 00 00 00 00 02 AD 03
                    15 01 00 00 00 00 02 AE FF
                    15 01 00 00 00 00 02 AF 00
                    15 01 00 00 00 00 02 B0 7C
                    15 01 00 00 00 00 02 B1 00
                    15 01 00 00 00 00 02 B2 95
                    15 01 00 00 00 00 02 B3 00
                    15 01 00 00 00 00 02 B4 B8
                    15 01 00 00 00 00 02 B5 00
                    15 01 00 00 00 00 02 B6 CB
                    15 01 00 00 00 00 02 B7 00
                    15 01 00 00 00 00 02 B8 E9
                    15 01 00 00 00 00 02 B9 00
                    15 01 00 00 00 00 02 BA EE
                    15 01 00 00 00 00 02 BB 01
                    15 01 00 00 00 00 02 BC 03
                    15 01 00 00 00 00 02 BD 01
                    15 01 00 00 00 00 02 BE 13
                    15 01 00 00 00 00 02 BF 01
                    15 01 00 00 00 00 02 C0 21
                    15 01 00 00 00 00 02 C1 01
                    15 01 00 00 00 00 02 C2 47
                    15 01 00 00 00 00 02 C3 01
                    15 01 00 00 00 00 02 C4 6E
                    15 01 00 00 00 00 02 C5 01
                    15 01 00 00 00 00 02 C6 A2
                    15 01 00 00 00 00 02 C7 01
                    15 01 00 00 00 00 02 C8 D0
                    15 01 00 00 00 00 02 C9 02
                    15 01 00 00 00 00 02 CA 15
                    15 01 00 00 00 00 02 CB 02
                    15 01 00 00 00 00 02 CC 4C
                    15 01 00 00 00 00 02 CD 02
                    15 01 00 00 00 00 02 CE 4D
                    15 01 00 00 00 00 02 CF 02
                    15 01 00 00 00 00 02 D0 81
                    15 01 00 00 00 00 02 D1 02
                    15 01 00 00 00 00 02 D2 B8
                    15 01 00 00 00 00 02 D3 02
                    15 01 00 00 00 00 02 D4 DB
                    15 01 00 00 00 00 02 D5 03
                    15 01 00 00 00 00 02 D6 0A
                    15 01 00 00 00 00 02 D7 03
                    15 01 00 00 00 00 02 D8 2B
                    15 01 00 00 00 00 02 D9 03
                    15 01 00 00 00 00 02 DA 5B
                    15 01 00 00 00 00 02 DB 03
                    15 01 00 00 00 00 02 DC 6C
                    15 01 00 00 00 00 02 DD 03
                    15 01 00 00 00 00 02 DE 84
                    15 01 00 00 00 00 02 DF 03
                    15 01 00 00 00 00 02 E0 B2
                    15 01 00 00 00 00 02 E1 03
                    15 01 00 00 00 00 02 E2 C3
                    15 01 00 00 00 00 02 E3 03
                    15 01 00 00 00 00 02 E4 D4
                    15 01 00 00 00 00 02 E5 03
                    15 01 00 00 00 00 02 E6 E5
                    15 01 00 00 00 00 02 E7 03
                    15 01 00 00 00 00 02 E8 F6
                    15 01 00 00 00 00 02 E9 03
                    15 01 00 00 00 00 02 EA FF
                    15 01 00 00 00 00 02 FF 00
                    15 01 00 00 00 00 02 FB 01*/
                    /*15 01 00 00 00 00 02 C2 03*/ /*video mode*/
                    15 01 00 00 00 00 02 C2 08 /*command mode */
                    15 01 00 00 00 00 02 BA 03
                    /* ce start */
                    15 01 00 00 00 00 02 FF 03
                    15 01 00 00 00 00 02 FB 01
                    15 01 00 00 00 00 02 18 00
                    15 01 00 00 00 00 02 19 00
                    15 01 00 00 00 00 02 1A 00
                    15 01 00 00 00 00 02 25 46
                    15 01 00 00 00 00 02 00 00
                    15 01 00 00 00 00 02 01 04
                    15 01 00 00 00 00 02 02 08
                    15 01 00 00 00 00 02 03 0C
                    15 01 00 00 00 00 02 04 10
                    15 01 00 00 00 00 02 05 14
                    15 01 00 00 00 00 02 06 18
                    15 01 00 00 00 00 02 07 1C
                    15 01 00 00 00 00 02 08 1C
                    15 01 00 00 00 00 02 09 18
                    15 01 00 00 00 00 02 0A 14
                    15 01 00 00 00 00 02 0B 10
                    15 01 00 00 00 00 02 0C 0C
                    15 01 00 00 00 00 02 0D 08
                    15 01 00 00 00 00 02 0E 04
                    15 01 00 00 00 00 02 0F 00
                    15 01 00 00 00 00 02 1B 2F
                    15 01 00 00 00 00 02 1C 00
                    15 01 00 00 00 00 02 1D 01
                    15 01 00 00 00 00 02 1E 02
                    15 01 00 00 00 00 02 1F 01
                    15 01 00 00 00 00 02 20 00
                    15 01 00 00 00 00 02 21 00
                    15 01 00 00 00 00 02 FF 00
                    /* ce end */

                    /*for pwm frequency 10.7KHZ */
                    15 01 00 00 00 00 02 FF 04
                    15 01 00 00 00 00 02 FB 01
                    15 01 00 00 00 00 02 0A 08
                    15 01 00 00 00 00 02 FF 00
                    15 01 00 00 00 00 02 FB 01
                    
                    /*15 01 00 00 00 00 02 51 FF
                    15 01 00 00 00 00 02 53 2C*/
                    15 01 00 00 00 00 02 55 91
					15 01 00 00 78 00 02 11 00
                    15 01 00 00 02 00 02 29 00];
		qcom,mdss-dsi-off-command = [15 01 00 00 32 00 02 28 00
					15 01 00 00 78 00 02 10 00];
		qcom,mdss-dsi-on-command-state = "dsi_lp_mode";
		qcom,mdss-dsi-off-command-state = "dsi_hs_mode";
		qcom,mdss-dsi-h-sync-pulse = <1>;
		qcom,mdss-dsi-traffic-mode = "burst_mode";
		qcom,mdss-dsi-bllp-eof-power-mode;
		qcom,mdss-dsi-bllp-power-mode;
		qcom,mdss-dsi-lane-0-state;
		qcom,mdss-dsi-lane-1-state;
		qcom,mdss-dsi-lane-2-state;
		qcom,mdss-dsi-lane-3-state;
		/* for command mode start */
    	qcom,mdss-dsi-te-pin-select = <1>;
		qcom,mdss-dsi-wr-mem-start = <0x2c>;
		qcom,mdss-dsi-te-dcs-command = <1>;
		qcom,mdss-dsi-te-check-enable;
		qcom,mdss-dsi-te-using-te-pin;
        /* for command mode end */
		qcom,mdss-dsi-panel-timings = [7d 25 1d 00 37 33 22 27 1e 03 04 00];
        /*qcom,mdss-dsi-panel-timings = [83 1e 13 00 34 3a 18 22 24 03 04 a0];*/
		qcom,mdss-dsi-t-clk-post = <0x20>;
		qcom,mdss-dsi-t-clk-pre = <0x2c>;
		qcom,mdss-dsi-bl-min-level = <1>;
		qcom,mdss-dsi-bl-max-level = <255>;
		qcom,mdss-dsi-dma-trigger = "trigger_sw";
		qcom,mdss-dsi-mdp-trigger = "none";
		qcom,mdss-dsi-bl-pmic-control-type = "bl_ctrl_dcs";
		qcom,mdss-dsi-reset-sequence = <1 2>, <0 5>, <1 25>;
		qcom,mdss-pan-physical-width-dimension = <59>;
		qcom,mdss-pan-physical-height-dimension = <104>;

	};
};
