/* Copyright (c) 2013, The Linux Foundation. All rights reserved.
 *
 * This program is free software; you can redistribute it and/or modify
 * it under the terms of the GNU General Public License version 2 and
 * only version 2 as published by the Free Software Foundation.
 *
 * This program is distributed in the hope that it will be useful,
 * but WITHOUT ANY WARRANTY; without even the implied warranty of
 * MERCHANTABILITY or FITNESS FOR A PARTICULAR PURPOSE.  See the
 * GNU General Public License for more details.
 */

/include/ "dsi-panel-hx8394a-720p-video.dtsi"
/include/ "dsi-panel-nt35590-720p-video.dtsi"
/include/ "dsi-panel-nt35521-720p-video.dtsi"
/include/ "dsi-panel-nt35596-1080p-video.dtsi"
/include/ "dsi-panel-nt35590-720p-cmd.dtsi"
/include/ "dsi-panel-ssd2080m-720p-video.dtsi"
/include/ "dsi-panel-jdi-1080p-video.dtsi"
/include/ "dsi-panel-otm1283a-boe-720p-video.dtsi"
/include/ "dsi-panel-otm1283a-auo-720p-video.dtsi"
/include/ "dsi-panel-otm1283a-cpt-720p-video.dtsi"
/include/ "dsi-panel-nt35590-tianma-720p-video.dtsi"
/include/ "dsi-panel-nt35590-auo-720p-video.dtsi"
/include/ "dsi-panel-hx8394d-lead-720p-5p5-video.dtsi"
/include/ "dsi-panel-hx8394d-tianma-720p-5p5-video.dtsi"
/include/ "dsi-panel-r61318a1-yushun-720p-5p5-video.dtsi"
